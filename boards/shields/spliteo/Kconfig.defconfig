## boards/shields/spliteo/Kconfig.defconfig
```kconfig
if SHIELD_SPLITEO_LEFT

config ZMK_KEYBOARD_NAME
    default "Spliteo"

config ZMK_SPLIT_ROLE_CENTRAL
    default y

endif

if SHIELD_SPLITEO_LEFT || SHIELD_SPLITEO_RIGHT

config ZMK_SPLIT
    default y

endif
```

## boards/shields/spliteo/Kconfig.shield
```kconfig
# Copyright (c) 2025 Ted Raykov
# SPDX-License-Identifier: MIT

config SHIELD_SPLITEO_LEFT
    def_bool $(shields_list_contains,spliteo_left)

config SHIELD_SPLITEO_RIGHT
    def_bool $(shields_list_contains,spliteo_right)
```

## west.yml
```yaml
manifest:
  remotes:
    - name: tedraykov
      url-base: https://github.com/tedraykov
  projects:
    - name: zmk-config
      remote: tedraykov
      import: west.yml
```
